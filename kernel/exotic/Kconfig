## kernel/exotic/reclaim/Kconfig
```kconfig
config EXOTIC_RECLAIM
	tristate "ExoticReclaim - Automatic cache cleaner"
	default y
	help
	  Automatically drop system cache every 3 hours after boot,
	  only when the screen is off for more than 10 minutes.
```

## kernel/irq/exoticbalance/Kconfig
```kconfig
# SPDX-License-Identifier: GPL-2.0-only

config EXOTICBALANCE
	bool "ExoticBalance IRQ Load Logger"
	default y
	help
	  Enables ExoticBalance, a custom IRQ load logger with GUI toggle support.
	  This module provides per-CPU IRQ counting and logs imbalance.
	  Toggle will appear in Franco Kernel Manager (/sys/module/exoticbalance/parameters/enabled).
```
